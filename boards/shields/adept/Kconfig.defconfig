## boards/shields/adept/Kconfig.defconfig
```kconfig
if SHIELD_ADEPT_BOARD

config ZMK_POINTING
    default y

config ZMK_KEYBOARD_NAME
	default "Trackball Adept"

config SPI
    default y

endif
```
